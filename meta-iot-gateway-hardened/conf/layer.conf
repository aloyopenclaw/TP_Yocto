## meta-iot-gateway-hardened/conf/layer.conf
```bitbake
BBPATH .= ":${LAYERDIR}"

BBFILES += "${LAYERDIR}/recipes-*/*/*.bb \
            ${LAYERDIR}/recipes-*/*/*.bbappend"

BBFILE_COLLECTIONS += "meta-iot-gateway-hardened"
BBFILE_PATTERN_meta-iot-gateway-hardened = "^${LAYERDIR}/recipes-*/"
BBFILE_PRIORITY_meta-iot-gateway-hardened = "6"

LAYERSERIES_CORENAMES += "scarthgap"
LAYERSERIES_COMPAT_meta-iot-gateway-hardened = "scarthgap"
LAYERVERSION_meta-iot-gateway-hardened = "1"

LAYERDEPENDS_meta-iot-gateway-hardened = "core"
LAYERRECOMMENDS_meta-iot-gateway-hardened = "openembedded-layer networking-layer"
```
